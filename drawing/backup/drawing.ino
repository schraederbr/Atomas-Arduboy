//Use this to get hex file:
//arduino-cli compile --fqbn arduboy:avr:arduboy .\drawing.ino --output-dir ./
#include <Arduboy2.h>
Arduboy2 arduboy;
const unsigned char PROGMEM background[] = {0x00, 0x00, 0x00, 0x00, 0x00, 0x00, 0x00, 0x00, 0x00, 0x00, 0x00, 0x00, 0x00,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 0x00,    };
int centerX = 64;
int centerY = 32;
int radius = 24;
int count = 1;
int index = 0;

//int nums[] = {1, 2, 3, 4, 5};
//degrees * pi/180
void setup() {
  arduboy.begin();
  arduboy.clear();
  // arduboy.print("Holmes is cool!");
  // arduboy.display();
  //arduboy.drawBitmap(0, 0, background, 128, 64, WHITE);
  //arduboy.display();
  // arduboy.print(sin(0.5));
  // arduboy.display();
  // arduboy.drawLine(1, 1, 50, 50, WHITE);
  // arduboy.display();
  //drawLineOnCircle(0.785f);
  //drawLines(5);
  //arduboy.drawLine(centerX, centerY, centerX + cos(0.785f) * radius, centerY + sin(0.785f) * radius, WHITE);
  //arduboy.drawCircle(64, 32, 5, WHITE);
  //arduboy.display();

  
  
}

// void drawCircle(int i){
//   arduboy.drawCircle(centerX + cos(i * currentStep) * radius, centerY + sin(i * currentStep) * radius, 5, WHITE);
// }

void drawAtom(int i, int num){
  float currentStep = 2 * PI / num;
  arduboy.drawCircle(centerX + cos(i * currentStep) * radius, centerY + sin(i * currentStep) * radius, 5, WHITE);
}

void drawCircles(){
  float currentStep = 2 * PI / count;
  for (int i = 0; i < count; i++){
    arduboy.drawCircle(centerX + cos(i * currentStep) * radius, centerY + sin(i * currentStep) * radius, 5, WHITE);
    //drawCircle(i);
  }
}

void drawLine(){
  float currentStep = 2 * PI / count;
  drawLineOnCircle(index * currentStep + currentStep/2);
}

void drawLineOnCircle(float angle){
  arduboy.drawLine(centerX, centerY, centerX + cos(angle) * radius, centerY + sin(angle) * radius, WHITE);
  return;
}

void loop() {
  
  arduboy.pollButtons();
  if (arduboy.justPressed(A_BUTTON)){
    count++;
  }

  if(arduboy.justPressed(LEFT_BUTTON)){
    if(index > 0){
      index--;
    }
    else{
      index = count - 1;
    }
  }
  
  if (arduboy.justPressed(RIGHT_BUTTON)){
    if(index < count - 1){
      index++;
    }
    else{
      index = 0;
    }
  }

  arduboy.clear();
  drawLine();
  //drawCircles();
  arduboy.display();

  
  // arduboy.drawBitmap(0, 0, background, 128, 64, WHITE);
  

}